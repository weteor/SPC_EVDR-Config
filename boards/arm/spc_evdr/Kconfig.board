## boards/arm/spc_evdr/Kconfig.board
```kconfig
# Copyright (c) 2022 @weteor
# SPDX-License-Identifier: MIT

config BOARD_SPC_EVDR
	bool "spc_evdr"
	depends on SOC_NRF52840_QIAA
```

## boards/arm/spc_evdr/Kconfig.defconfig
```kconfig
# Copyright (c) 2022 @weteor
# SPDX-License-Identifier: MIT

if BOARD_SPC_EVDR

config BOARD
	default "spc_evdr"

config ZMK_KEYBOARD_NAME
	default "spc_evdr"

if USB

config USB_NRFX
	default y

config USB_DEVICE_STACK
	default y

endif # USB

config BT_CTLR
	default BT

config ZMK_BLE
	default y

config ZMK_USB
	default y

config ZMK_BATTERY_VOLTAGE_DIVIDER
	default y

config ZMK_DISPLAY
  select LVGL_USE_IMG
  # default y
  
choice ZMK_DISPLAY_STATUS_SCREEN
        default ZMK_DISPLAY_STATUS_SCREEN_CUSTOM
endchoice

if ZMK_DISPLAY

config I2C
	default y

config SSD1306
	default y

config SSD1306_REVERSE_MODE
	default y

endif # ZMK_DISPLAY

if LVGL
config LVGL_HOR_RES_MAX
	default 128

config LVGL_VER_RES_MAX
	default 32

config LVGL_VDB_SIZE
	default 64

config LVGL_DPI
	default 148

config LVGL_BITS_PER_PIXEL
	default 1

choice LVGL_COLOR_DEPTH
	default LVGL_COLOR_DEPTH_1
endchoice

endif # LVGL

CONFIG_BUILD_OUTPUT_UF2=y

endif # BOARD_SPC_EVDR
```

## boards/shields/spc_evdr/Kconfig.defconfig
```kconfig
# Copyright (c) 2022 @weteor
# SPDX-License-Identifier: MIT

if SHIELD_SPC_EVDR

config ZMK_KEYBOARD_NAME
    default "SPC EVDR"

config I2C
    default y
    
config GPIO_PCA95XX
    default y
    
config ZMK_DISPLAY
  select LVGL_USE_IMG
  # default y
  
choice ZMK_DISPLAY_STATUS_SCREEN
        default ZMK_DISPLAY_STATUS_SCREEN_CUSTOM
endchoice

if ZMK_DISPLAY

config SSD1306
	default y

endif # ZMK_DISPLAY

if LVGL
config LV_Z_MEM_POOL_SIZE
     default 4096

config LV_Z_VDB_SIZE
	default 64

config LV_DPI_DEF
	default 148

config LV_Z_BITS_PER_PIXEL
	default 1

choice LV_COLOR_DEPTH
	default LV_COLOR_DEPTH_1
endchoice

endif # LVGL

endif # SHIELD_SPC_EVDR
```

## boards/shields/spc_evdr/Kconfig.shield
```kconfig
# Copyright (c) 2022 @weteor
# SPDX-License-Identifier: MIT

config SHIELD_SPC_EVDR
   def_bool $(shields_list_contains,spc_evdr)
```
